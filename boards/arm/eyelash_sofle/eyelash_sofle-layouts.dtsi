#include <physical_layouts.dtsi>

/ {
    eyelash_sofle_layout: eyelash_sofle_layout {
        compatible = "zmk,physical-layout";
        display-name = "Layout";
        transform = <&default_transform>;
keys  //                     w   h   x  y  rot rx ry
=	<&key_physical_attrs	100	100	300	0.0	0	0	0	>
,	<&key_physical_attrs	100	100	1425	0.0	0	0	0	>
,	<&key_physical_attrs	100	100	200	12.5	0	0	0	>
,	<&key_physical_attrs	100	100	400	13.0	0	0	0	>
,	<&key_physical_attrs	100	100	1325	13.0	0	0	0	>
,	<&key_physical_attrs	100	100	1525	13.0	0	0	0	>
,	<&key_physical_attrs	100	100	500	25.0	0	0	0	>
,	<&key_physical_attrs	100	100	1225	25.0	0	0	0	>
,	<&key_physical_attrs	100	100	0	37.5	0	0	0	>
,	<&key_physical_attrs	100	100	100	37.5	0	0	0	>
,	<&key_physical_attrs	100	100	1625	38.0	0	0	0	>
,	<&key_physical_attrs	100	100	1725	38.0	0	0	0	>
,	<&key_physical_attrs	100	100	600	50.0	0	0	0	>
,	<&key_physical_attrs	100	100	1125	50.0	0	0	0	>
,	<&key_physical_attrs	100	100	300	100.0	0	0	0	>
,	<&key_physical_attrs	100	100	1425	100.0	0	0	0	>
,	<&key_physical_attrs	100	100	200	112.5	0	0	0	>
,	<&key_physical_attrs	100	100	400	113.0	0	0	0	>
,	<&key_physical_attrs	100	100	1325	113.0	0	0	0	>
,	<&key_physical_attrs	100	100	1525	113.0	0	0	0	>
,	<&key_physical_attrs	100	100	500	125.0	0	0	0	>
,	<&key_physical_attrs	100	100	1225	125.0	0	0	0	>
,	<&key_physical_attrs	100	100	0	137.5	0	0	0	>
,	<&key_physical_attrs	100	100	100	137.5	0	0	0	>
,	<&key_physical_attrs	100	100	1625	138.0	0	0	0	>
,	<&key_physical_attrs	100	100	1725	138.0	0	0	0	>
,	<&key_physical_attrs	100	100	600	150.0	0	0	0	>
,	<&key_physical_attrs	100	100	1125	150.0	0	0	0	>
,	<&key_physical_attrs	100	100	300	200.0	0	0	0	>
,	<&key_physical_attrs	100	100	1425	200.0	0	0	0	>
,	<&key_physical_attrs	100	100	200	212.5	0	0	0	>
,	<&key_physical_attrs	100	100	400	213.0	0	0	0	>
,	<&key_physical_attrs	100	100	1325	213.0	0	0	0	>
,	<&key_physical_attrs	100	100	1525	213.0	0	0	0	>
,	<&key_physical_attrs	100	100	500	225.0	0	0	0	>
,	<&key_physical_attrs	100	100	1225	225.0	0	0	0	>
,	<&key_physical_attrs	100	100	0	237.5	0	0	0	>
,	<&key_physical_attrs	100	100	100	237.5	0	0	0	>
,	<&key_physical_attrs	100	100	1625	238.0	0	0	0	>
,	<&key_physical_attrs	100	100	1725	238.0	0	0	0	>
,	<&key_physical_attrs	100	100	600	250.0	0	0	0	>
,	<&key_physical_attrs	100	100	1125	250.0	0	0	0	>
,	<&key_physical_attrs	100	100	300	300.0	0	0	0	>
,	<&key_physical_attrs	100	100	1425	300.0	0	0	0	>
,	<&key_physical_attrs	100	100	200	313.0	0	0	0	>
,	<&key_physical_attrs	100	100	400	313.0	0	0	0	>
,	<&key_physical_attrs	100	100	1325	313.0	0	0	0	>
,	<&key_physical_attrs	100	100	1525	313.0	0	0	0	>
,	<&key_physical_attrs	100	100	500	325.0	0	0	0	>
,	<&key_physical_attrs	100	100	1225	325.0	0	0	0	>
,	<&key_physical_attrs	100	100	0	337.5	0	0	0	>
,	<&key_physical_attrs	100	100	100	337.5	0	0	0	>
,	<&key_physical_attrs	100	100	1625	338.0	0	0	0	>
,	<&key_physical_attrs	100	100	1725	338.0	0	0	0	>
,	<&key_physical_attrs	100	100	600	350.0	0	0	0	>
,	<&key_physical_attrs	100	100	1125	350.0	0	0	0	>
,	<&key_physical_attrs	100	100	300	400.0	0	0	0	>
,	<&key_physical_attrs	100	100	1425	400.0	0	0	0	>
,	<&key_physical_attrs	100	100	200	413.0	0	0	0	>
,	<&key_physical_attrs	100	100	400	413.0	0	0	0	>
,	<&key_physical_attrs	100	100	1325	413.0	0	0	0	>
,	<&key_physical_attrs	100	100	1525	413.0	0	0	0	>
,	<&key_physical_attrs	100	100	500	425.0	0	0	0	>
,	<&key_physical_attrs	100	100	1225	425.0	0	0	0	>
,	<&key_physical_attrs	100	100	0	437.5	0	0	0	>
,	<&key_physical_attrs	100	100	100	437.5	0	0	0	>
,	<&key_physical_attrs	100	100	1625	438.0	0	0	0	>
,	<&key_physical_attrs	100	100	1725	438.0	0	0	0	>
,	<&key_physical_attrs	100	100	600	450.0	0	0	0	>
,	<&key_physical_attrs	100	100	1125	450.0	0	0	0	>
,	<&key_physical_attrs	100	100	300	500.0	0	0	0	>
,	<&key_physical_attrs	100	100	1425	500.0	0	0	0	>
,	<&key_physical_attrs	100	100	200	513.0	0	0	0	>
,	<&key_physical_attrs	100	100	400	513.0	0	0	0	>
,	<&key_physical_attrs	100	100	1325	513.0	0	0	0	>
,	<&key_physical_attrs	100	100	1525	513.0	0	0	0	>
,	<&key_physical_attrs	100	100	500	525.0	0	0	0	>
,	<&key_physical_attrs	100	100	1225	525.0	0	0	0	>
,	<&key_physical_attrs	100	100	0	537.5	0	0	0	>
,	<&key_physical_attrs	100	100	100	537.5	0	0	0	>
,	<&key_physical_attrs	100	100	1625	538.0	0	0	0	>
,	<&key_physical_attrs	100	100	1725	538.0	0	0	0	>
,	<&key_physical_attrs	100	100	600	550.0	0	0	0	>
,	<&key_physical_attrs	100	100	1125	550.0	0	0	0	>

            ;
    };
};
