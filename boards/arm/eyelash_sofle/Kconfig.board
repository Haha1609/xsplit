## boards/arm/eyelash_sofle/Kconfig.board
```kconfig
#
# Copyright (c) 2024 The ZMK Contributors
# SPDX-License-Identifier: MIT
#

config BOARD_XSPLIT_LEFT
    bool "xsplit left"
    depends on SOC_NRF52840_QIAA

config BOARD_XSPLIT_RIGHT
    bool "xsplit right"
    depends on SOC_NRF52840_QIAA
```
